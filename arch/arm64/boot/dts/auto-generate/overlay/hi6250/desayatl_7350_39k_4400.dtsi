/* DO NOT EDIT - Automatically generated by python */
		&desayatl_7350_39k_4400 {
			fcc = <7350>;
			default_rbatt_mohm = <100>;
			identify_type = "id_volt";
			id_identify_min = <1235>;
			id_identify_max = <1759>;
			id_voltage_min = <1420>;
			id_voltage_max = <1562>;
			vbat_max = <4400>;
			temp_para = 
						"-32767","0","-1","0","4100","0",
						"0","5","-1","735","4400","0",
						"5","10","-1","2205","4400","3",
						"10","45","-1","-1","4400","3",
						"45","50","-1","2572","4100","3",
						"50","32767","-1","0","4100","0";
			vbat_para = 
						"-32767","3400","-1","820","0",
						"3400","32767","-1","-1","0";
			segment_para = 
						"-32767","4150","7350","4208","50",
						"4150","4450","5145","4400","0";
			batt_brand = "desayatl";
			fcc_temp = <7390 7429 7381 7486 7383 7360>;
			fcc_sf_x = <0 100 200 300 400 500 600 700 800 1000 1500>;
			fcc_sf_y = <100 96 94 92 90 88 87 84 81 75 50>;
			fcc_sf_cols = <11>;
			pc_sf_rows = <1>;
			pc_sf_cols = <1>;
			pc_sf_row_entries = <0>;
			pc_sf_percent = <100>;
			pc_sf_sf = <100>;
			rbatt_sf_rows = <28>;
			rbatt_sf_cols = <6>;
			rbatt_sf_percent = <100 95 90 85 80 75 70 65 60 55 50 45 40 35 30 25 20 15 10 9 8 7 6 5 4 3 2 1>;
			rbatt_sf_sf = <
			               1020 763 346 95 80 76
			               1019 763 346 95 80 76
			               955 713 340 95 80 77
			               898 670 333 95 81 77
			               868 630 330 96 81 78
			               852 615 333 98 83 79
			               788 584 333 103 85 79
			               785 536 319 108 88 81
			               779 534 307 112 93 84
			               774 524 292 96 83 78
			               787 519 290 91 80 76
			               806 530 294 92 80 77
			               830 554 308 94 82 78
			               857 581 332 96 84 80
			               890 614 360 97 85 80
			               927 650 393 96 81 77
			               982 689 433 93 80 77
			               1064 737 482 94 80 77
			               1339 686 485 98 82 78
			               1581 732 401 98 84 81
			               1702 790 428 99 85 81
			               1835 872 462 100 86 80
			               1951 963 502 100 86 81
			               2087 1041 540 99 84 80
			               2265 1072 564 99 83 80
			               2457 1241 605 103 85 79
			               2686 1368 688 111 88 83
			               2980 1546 821 197 99 88
			              >;
			pc_temp_ocv_rows = <29>;
			pc_temp_ocv_cols = <6>;
			pc_temp_ocv_percent = <100 95 90 85 80 75 70 65 60 55 50 45 40 35 30 25 20 15 10 9 8 7 6 5 4 3 2 1>;
			pc_temp_ocv_ocv = <
			                   4386 4386 4380 4378 4371 4363
			                   4292 4306 4309 4320 4314 4304
			                   4228 4238 4247 4263 4258 4248
			                   4164 4183 4191 4206 4201 4192
			                   4114 4125 4136 4150 4145 4138
			                   4063 4080 4087 4097 4093 4086
			                   3979 4020 4032 4049 4044 4037
			                   3936 3950 3976 3998 3997 3993
			                   3893 3911 3929 3954 3957 3952
			                   3857 3872 3883 3900 3900 3896
			                   3833 3838 3848 3863 3863 3861
			                   3814 3816 3820 3836 3837 3835
			                   3800 3802 3802 3815 3816 3813
			                   3785 3791 3791 3797 3798 3795
			                   3771 3780 3781 3780 3781 3776
			                   3754 3765 3769 3762 3755 3744
			                   3736 3744 3752 3740 3733 3721
			                   3719 3720 3722 3714 3707 3694
			                   3698 3697 3693 3690 3683 3671
			                   3692 3692 3690 3688 3681 3670
			                   3683 3687 3686 3687 3680 3668
			                   3673 3682 3683 3684 3678 3665
			                   3658 3674 3677 3676 3671 3658
			                   3636 3656 3662 3656 3652 3635
			                   3605 3621 3629 3615 3614 3595
			                   3561 3572 3578 3558 3560 3543
			                   3495 3502 3509 3482 3491 3474
			                   3401 3398 3409 3373 3389 3375
			                   3200 3200 3200 3200 3200 3200
			                  >;
			vol_dec0=  <400>;
			pc_temp_ocv_ocv0 = < 
			                   3986 3986 3980 3978 3971 3963
			                   3984 3974 3979 3967 3962 3957
			                   3981 3961 3974 3939 3937 3941
			                   3953 3942 3941 3903 3901 3905
			                   3919 3913 3908 3877 3876 3878
			                   3886 3883 3877 3857 3856 3857
			                   3858 3856 3852 3839 3839 3840
			                   3839 3833 3830 3825 3825 3825
			                   3823 3817 3813 3812 3811 3810
			                   3809 3805 3801 3799 3800 3799
			                   3798 3797 3793 3788 3789 3787
			                   3786 3788 3786 3778 3776 3772
			                   3775 3780 3778 3767 3760 3751
			                   3763 3770 3771 3753 3745 3735
			                   3749 3756 3758 3738 3730 3719
			                   3736 3738 3740 3722 3713 3701
			                   3722 3720 3718 3701 3696 3685
			                   3706 3704 3697 3690 3682 3671
			                   3681 3685 3683 3681 3675 3663
			                   3674 3680 3681 3674 3670 3657
			                   3664 3675 3675 3663 3657 3643
			                   3649 3663 3663 3639 3637 3620
			                   3629 3639 3644 3610 3608 3592
			                   3603 3610 3611 3576 3575 3558
			                   3569 3574 3572 3531 3536 3518
			                   3523 3522 3523 3478 3486 3471
			                   3461 3455 3462 3415 3426 3411
			                   3378 3356 3376 3325 3346 3325
			                   3200 3200 3200 3200 3200 3200
			                  >;
		};
